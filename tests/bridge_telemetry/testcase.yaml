## tests/bridge_telemetry/testcase.yaml
```yaml
tests:
  bridge_telemetry.policy:
    platform_allow: native_sim
    tags: bridge_telemetry
```

## tests/status_led_policy/testcase.yaml
```yaml
tests:
  esp_nmea_bridge.status_led_policy:
    platform_allow: native_sim
    tags: status_led
```
